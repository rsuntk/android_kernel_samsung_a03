## Rissu/kernel_manifest/Kconfig
```kconfig
#
# Rissu Projects (C) 2024
# Additional kernel patches by Rissu
#

config RISSU_KERNEL_PATCHES
    tristate "Rissu Kernel module"
    default n
    help
        Enable rissu kernel. Use m for .ko, y for inline build
        n for not build the module.
        
config RISSU_SYSFS_PATCH
	bool "Enable rissu's rq_affinity patches"
	default n
	help
		Force rq_affinity flags to 2
		
# rissu_sprd spesified
config RISSU_SPRD_OC
    bool "Enable unisoc/sprd oc"
    default n
    help
        Overclock CPU and GPU
        
config RISSU_FORCE_LZ4
    bool "Use LZ4 as default zram compressor"
    default n
    help
        Use LZ4 as default zram compressor
```
